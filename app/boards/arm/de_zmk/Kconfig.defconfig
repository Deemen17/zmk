## app/boards/arm/de_zmk/Kconfig.defconfig
```kconfig
# Copyright (c) 2025 Deemen17 Works
# SPDX-License-Identifier: MIT

if BOARD_DE_ZMK

config BOARD
    default "de_zmk"

if USB_DEVICE_STACK

config USB_NRFX
    default y

endif # USB_DEVICE_STACK

config BT_CTLR
    default BT

endif 
```

## app/boards/arm/deky65/deky65_defconfig
```kconfig
# Copyright (c) 2025 Deemen17 Works
# SPDX-License-Identifier: MIT


# --- Default Configuration ---
CONFIG_SOC_SERIES_NRF52X=y
CONFIG_SOC_NRF52840_QIAA=y
CONFIG_ARM_MPU=y
CONFIG_PINCTRL=y
CONFIG_GPIO=y
CONFIG_USE_DT_CODE_PARTITION=y
CONFIG_BUILD_OUTPUT_UF2=y
CONFIG_MPU_ALLOW_FLASH_WRITE=y
CONFIG_NVS=y
CONFIG_SETTINGS_NVS=y
CONFIG_FLASH=y
CONFIG_FLASH_PAGE_LAYOUT=y
CONFIG_FLASH_MAP=y

# --- Board Configuration ---
CONFIG_BOARD_DEKY65=y

# --- RGB Underglow Configuration ---
CONFIG_ZMK_RGB_UNDERGLOW=n
CONFIG_WS2812_STRIP=n
CONFIG_ZMK_RGB_UNDERGLOW_EXT_POWER=n
CONFIG_ZMK_RGB_UNDERGLOW_AUTO_OFF_IDLE=n
CONFIG_ZMK_RGB_UNDERGLOW_ON_START=n

# --- External Power Control ---
CONFIG_ZMK_EXT_POWER=n

# --- Logging Configuration ---
CONFIG_ZMK_USB_LOGGING=n
CONFIG_SENSOR_LOG_LEVEL_DBG=n

# --- Power Management ---
# Idle timeout: 45 minutes (ms) = 2700000
CONFIG_ZMK_IDLE_TIMEOUT=2700000  
CONFIG_ZMK_SLEEP=y
# Sleep timeout: 1 hour (ms) = 3600000
CONFIG_ZMK_IDLE_SLEEP_TIMEOUT=3600000
CONFIG_ZMK_PM_SOFT_OFF=y

# --- Battery Configuration ---
CONFIG_ZMK_BATTERY=y
CONFIG_ZMK_BATTERY_REPORTING=y

# --- ZMK Studio Configuration ---
CONFIG_ZMK_STUDIO=y
CONFIG_ZMK_STUDIO_LOCKING=n
CONFIG_ZMK_STUDIO_LOCK_ON_DISCONNECT=n				

# --- Boosting Bluetooth Connection ---
CONFIG_BT_CTLR_TX_PWR_PLUS_8=y
CONFIG_ZMK_BLE_EXPERIMENTAL_CONN=y

# --- USB Configuration ---
CONFIG_USB_DEVICE_MANUFACTURER="DEEMEN17 WORKS"
CONFIG_USB_DEVICE_PRODUCT="DEKY65"

# --- HID Indicators ---
CONFIG_ZMK_HID_INDICATORS=y

# --- LED Configuration ---
CONFIG_LED=y

# --- Keyscan Debounce ---
CONFIG_ZMK_KSCAN_DEBOUNCE_PRESS_MS=5
CONFIG_ZMK_KSCAN_DEBOUNCE_RELEASE_MS=5

# --- RGBLED Widget Configuration ---
CONFIG_RGBLED_WIDGET=y
CONFIG_RGBLED_WIDGET_CAPS=y
CONFIG_RGBLED_WIDGET_CONN_BLINK_MS=500

# --- Internal Crystal Only ---
CONFIG_CLOCK_CONTROL_NRF_K32SRC_RC=y
CONFIG_CLOCK_CONTROL_NRF_K32SRC_500PPM=y
```

## app/boards/arm/supermini_g80_1207/Kconfig.board
```kconfig
# BT60 board configuration

# Copyright (c) 2021 Polarity Works
# SPDX-License-Identifier: MIT

config BOARD_SUPERMINI_G80_1207
    bool "supermini_g80_1207"
    depends on SOC_NRF52840_QIAA
```

## app/boards/arm/supermini_g80_1207/Kconfig.defconfig
```kconfig
# Copyright (c) 2021 Polarity Works
# SPDX-License-Identifier: MIT

if BOARD_SUPERMINI_G80_1207

config ZMK_KEYBOARD_NAME
    default "BIG BEIGE BOY"

if USB

config USB_NRFX
    default y

config USB_DEVICE_STACK
    default y

endif # USB

config BT_CTLR
    default BT

config ZMK_BLE
	default y

config ZMK_USB
	default y

config I2C
	default y

endif # BOARD_SUPERMINI_G80_1207
```

## app/boards/arm/supermini_g80_1207/supermini_g80_1207_defconfig
```kconfig
# Copyright (c) 2025 DEEMEN17 WORKS
# SPDX-License-Identifier: MIT

CONFIG_SOC_SERIES_NRF52X=y
CONFIG_SOC_NRF52840_QIAA=y
CONFIG_BOARD_SUPERMINI_G80_1207=y

# Enable MPU
CONFIG_ARM_MPU=y

CONFIG_PINCTRL=y

# enable GPIO
CONFIG_GPIO=y

CONFIG_USE_DT_CODE_PARTITION=y
CONFIG_BUILD_OUTPUT_UF2=y

CONFIG_MPU_ALLOW_FLASH_WRITE=y
CONFIG_NVS=y
CONFIG_SETTINGS_NVS=y
CONFIG_FLASH=y
CONFIG_FLASH_PAGE_LAYOUT=y
CONFIG_FLASH_MAP=y

CONFIG_ZMK_USB=y
CONFIG_ZMK_BLE=y

CONFIG_I2C=y
CONFIG_GPIO_MCP230XX=y

CONFIG_ZMK_BATTERY=y
CONFIG_ZMK_BATTERY_REPORTING=y

CONFIG_ZMK_STUDIO=y
CONFIG_ZMK_STUDIO_LOCKING=n
CONFIG_ZMK_STUDIO_LOCK_ON_DISCONNECT=n		

CONFIG_ZMK_HID_REPORT_TYPE_NKRO=y
```

## app/boards/de/de60_ble_red_test/Kconfig.defconfig
```kconfig
# Copyright (c) 2025 Deemen17 Works
# SPDX-License-Identifier: MIT

if BOARD_DE60_BLE_RED_TEST

config ZMK_KEYBOARD_NAME
    default "DE60 BLE RED"

if USB

config USB_NRFX
	default y

config USB_DEVICE_STACK
	default y

endif # USB

config BT_CTLR
	default BT

config ZMK_BLE
	default y

config ZMK_USB
	default y

config ZMK_BATTERY_VOLTAGE_DIVIDER
	default y

config RGBLED_WIDGET_CAPS
	default y

config ZMK_BATTERY_REPORTING
	default y

endif # BOARD_DE60_BLE_RED_TEST
```

## app/boards/de/de_zmk/Kconfig.board
```kconfig
# Copyright (c) 2025 Deemen17 Works
# SPDX-License-Identifier: MIT

config BOARD_DE_ZMK
    bool "de_zmk"
    depends on SOC_NRF52840_QIAA
```

## app/boards/de/vua/Kconfig.defconfig
```kconfig
#
# Copyright (c) 2023 Deemen17
# SPDX-License-Identifier: MIT
#

if BOARD_VUA_LEFT

config BOARD
    default "VUA LEFT"

config ZMK_SPLIT_ROLE_CENTRAL
    default y

endif # BOARD_VUA_LEFT

if BOARD_VUA_RIGHT

config BOARD
    default "VUA RIGHT"

endif # BOARD_VUA_RIGHT

if BOARD_VUA_RIGHT || BOARD_VUA_LEFT

config ZMK_SPLIT
    default y

config BT_CTLR
    default BT

config ZMK_KSCAN_MATRIX_WAIT_BETWEEN_OUTPUTS
    default 5

config PINCTRL
    default y

if USB

config USB_NRFX
    default y

config USB_DEVICE_STACK
    default y

endif # USB

endif # BOARD_VUA_LEFT || BOARD_VUA_RIGHT
```

## app/boards/de/vua/Kconfig.vua_left
```kconfig
# Copyright (c) 2023 Deemen17
# SPDX-License-Identifier: MIT

config BOARD_VUA_LEFT
    select SOC_NRF52840_QIAA
    imply RETAINED_MEM
    imply RETENTION
    imply RETENTION_BOOT_MODE
```

## app/boards/de/vua/board.yml
```yaml
boards:
  - name: vua_left
    vendor: de
    socs:
      - name: nrf52840
  - name: vua_right
    vendor: de
    socs:
      - name: nrf52840
```

## app/boards/de/vua/vua_right_defconfig
```kconfig
#
# Copyright (c) 2023 Deemen17
# SPDX-License-Identifier: MIT
#

# Enable both USB and BLE
CONFIG_ZMK_USB=y
CONFIG_ZMK_BLE=y

# Keyboard IDs
CONFIG_ZMK_KEYBOARD_NAME="VUA RIGHT"
CONFIG_USB_DEVICE_PID=0xea65
CONFIG_USB_DEVICE_VID=0xde17
CONFIG_USB_DEVICE_MANUFACTURER="EagleV"

CONFIG_BT_DIS_PNP_PID=0xea65
CONFIG_BT_DIS_PNP_VID=0xde17
CONFIG_BT_DIS_MANUF="EagleV"
CONFIG_BT_DIS_MODEL="VUA RIGHT"

CONFIG_BT_CTLR_TX_PWR_PLUS_8=y

# Enable GPIO
CONFIG_GPIO=y

# Build configurations
CONFIG_BUILD_OUTPUT_UF2=y

# Flash configuration
CONFIG_MPU_ALLOW_FLASH_WRITE=y
CONFIG_NVS=y
CONFIG_SETTINGS_NVS=y
CONFIG_FLASH=y
CONFIG_FLASH_PAGE_LAYOUT=y
CONFIG_FLASH_MAP=y

# The full two-byte consumer report space has compatibility issues with some
# operating systems, most notably macOS. Use the more basic single-byte usage
# space.
CONFIG_ZMK_HID_CONSUMER_REPORT_USAGES_BASIC=y

# Work-around for Windows bug with battery notifications
CONFIG_BT_GATT_ENFORCE_SUBSCRIPTION=n
CONFIG_CLOCK_CONTROL_NRF_K32SRC_XTAL=y
```

## app/boards/dekb/de_nrf52840/Kconfig.de_nrf52840
```kconfig
# Copyright (c) 2026 DEKB
# SPDX-License-Identifier: Apache-2.0

config BOARD_DE_NRF52840
    select SOC_NRF52840_QIAA
    select ZMK_BOARD_COMPAT 
    imply RETAINED_MEM 
    imply RETENTION 
    imply RETENTION_BOOT_MODE 
```

## app/boards/dekb/de_nrf52840/board.yml
```yaml
board:
  name: de_nrf52840
  vendor: dekb
  revision:
    format: major.minor.patch
    default: 1.0.0
    revisions:
      - name: 1.0.0
  socs:
    - name: nrf52840
```

## app/boards/shields/de60/Kconfig.shield
```kconfig
# Copyright (c) 2020 The ZMK Contributors
# SPDX-License-Identifier: MIT

config SHIELD_DE60_PROTO
    def_bool $(shields_list_contains,de60_proto)
```

## app/boards/shields/de60_ble_proto/Kconfig.defconfig
```kconfig
# Copyright (c) 2020 The ZMK Contributors
# SPDX-License-Identifier: MIT

# all use the same settings. remove #if

config ZMK_KEYBOARD_NAME
    default "de60"

config LED
    default y
```

## app/boards/shields/de60_ble_proto/Kconfig.shield
```kconfig
# Copyright (c) 2020 The ZMK Contributors
# SPDX-License-Identifier: MIT

config SHIELD_DE60__BLE_PROTO
    def_bool $(shields_list_contains,de60_ble_proto)
```

## app/boards/shields/de60_ble_proto/boards/de_nrf52840.conf
```kconfig
# Copyright (c) 2020 The ZMK Contributors
# SPDX-License-Identifier: MIT

# USB
CONFIG_ZMK_USB=y
CONFIG_USB_DEVICE_VID=0xDE17
CONFIG_USB_DEVICE_PID=0x60BE
CONFIG_USB_DEVICE_MANUFACTURER="DEKB"
CONFIG_ZMK_KEYBOARD_NAME="DE60 BLE PROTO"

# BLE
CONFIG_ZMK_BLE=y
CONFIG_BT_DEVICE_NAME_MAX=23
CONFIG_BT_DEVICE_NAME="DE60 BLE PROTO"
CONFIG_ZMK_BLE_EXPERIMENTAL_CONN=y
CONFIG_BT_CTLR_TX_PWR_PLUS_8=y

# SLEEP
CONFIG_ZMK_IDLE_TIMEOUT=30000
# 30 seconds 
CONFIG_ZMK_SLEEP=y
CONFIG_ZMK_IDLE_SLEEP_TIMEOUT=1200000


# HID
CONFIG_ZMK_HID_CONSUMER_REPORT_USAGES_FULL=y
# CONFIG_ZMK_HID_GENERIC_DESKTOP_USAGES_BASIC=y
CONFIG_ZMK_POINTING=y
CONFIG_ZMK_HID_INDICATORS=y

# DEBOUNCE
CONFIG_ZMK_KSCAN_DEBOUNCE_PRESS_MS=3
CONFIG_ZMK_KSCAN_DEBOUNCE_RELEASE_MS=5

# STUDIO
CONFIG_ZMK_STUDIO=y
CONFIG_ZMK_STUDIO_LOCKING=n
CONFIG_ZMK_STUDIO_LOCK_ON_DISCONNECT=n

CONFIG_ZMK_EXT_POWER=y
CONFIG_ZMK_PM_SOFT_OFF=y

# RGB UNDERGLOW
CONFIG_ZMK_RGB_UNDERGLOW=y
CONFIG_ZMK_RGB_UNDERGLOW_EXT_POWER=y
CONFIG_ZMK_RGB_UNDERGLOW_AUTO_OFF_IDLE=y
CONFIG_ZMK_RGB_UNDERGLOW_EFF_START=3
CONFIG_ZMK_RGB_UNDERGLOW_SPD_START=5

# BATTERY REPORTING
CONFIG_ZMK_BATTERY_REPORTING=y
```

## app/boards/shields/fspring/Kconfig.defconfig
```kconfig
# Copyright (c) 2021 The ZMK Contributors
# SPDX-License-Identifier: MIT

if SHIELD_FSPRING

config ZMK_KEYBOARD_NAME
    default "FSPRING-ZMK-BLE"

endif
```

## app/boards/shields/fspring/Kconfig.shield
```kconfig
# Copyright (c) 2021 The ZMK Contributors
# SPDX-License-Identifier: MIT

config SHIELD_FSPRING
    def_bool $(shields_list_contains,fspring)
```
